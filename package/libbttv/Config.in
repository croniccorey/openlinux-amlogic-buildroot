## package/libbttv/Config.in
```kconfig
config BR2_PACKAGE_LIBBTTV
	bool "libbttv"
	select BR2_PACKAGE_LIBXFER
	select BR2_PACKAGE_QT
        help
          bttv lib
```

## package/multimedia/amremote_config/Config.in
```kconfig
config BR2_PACKAGE_AMREMOTE_CONFIG
	bool "amremote_config"
	help
	  amlogic remote configure tool.

	  http://openlinux.amlogic.com
```
